## apps/examples/aifw_test/aifw_test_main/Kconfig
```kconfig
#
# For a description of the syntax of this configuration file,
# see kconfig-language at https://www.kernel.org/doc/Documentation/kbuild/kconfig-language.txt
#

config EXAMPLES_AIFW_TEST
	bool "AIFW test application"
	default n
	depends on AIFW
	---help---
		AIFW test application

config USER_ENTRYPOINT
	string
	default "aifw_test_main" if ENTRY_AIFW_TEST
```
